## config/west.yml
```yaml
manifest:
  remotes:
    - name: zmkfirmware
      url-base: https://github.com/zmkfirmware
    - name: keychron
      url-base: https://github.com/Keychron
  projects:
    - name: keychron_zmk_source
      remote: keychron
      repo: zmk
      revision: zmk
      import: app/west.yml
  self:
    path: config
```
